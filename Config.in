## configs/rock4d_defconfig
```kconfig
BR2_aarch64=y
BR2_cortex_a72_a53=y
BR2_PACKAGE_HOST_LINUX_HEADERS_CUSTOM_6_1=y
BR2_TARGET_GENERIC_HOSTNAME="rock-4d"
BR2_TARGET_GENERIC_ISSUE="Welcome to Buildroot for Radxa ROCK 4D"
BR2_ROOTFS_DEVICE_CREATION_DYNAMIC_MDEV=y
BR2_SYSTEM_DHCP="eth0"

BR2_ROOTFS_POST_BUILD_SCRIPT="board/radxa/rock4d/post-build.sh"
BR2_ROOTFS_POST_IMAGE_SCRIPT="board/radxa/rock4d/post-image.sh support/scripts/genimage.sh"
BR2_ROOTFS_POST_SCRIPT_ARGS="-c board/radxa/rock4d/genimage.cfg"

BR2_LINUX_KERNEL=y
BR2_LINUX_KERNEL_CUSTOM_TARBALL=y
BR2_LINUX_KERNEL_CUSTOM_TARBALL_LOCATION="file:///home/quangnm/workdir/buildroot/kernel-6.1.tar.gz"
BR2_LINUX_KERNEL_USE_DEFCONFIG=y
BR2_LINUX_KERNEL_DEFCONFIG="rockchip_linux"
BR2_LINUX_KERNEL_DTS_SUPPORT=y
BR2_LINUX_KERNEL_INTREE_DTS_NAME="rockchip/rk3576-rock-4d"
BR2_LINUX_KERNEL_INSTALL_TARGET=y
BR2_LINUX_KERNEL_NEEDS_HOST_OPENSSL=y
BR2_LINUX_KERNEL_NEEDS_HOST_PYTHON3=y

BR2_TARGET_ROOTFS_EXT2=y
BR2_TARGET_ROOTFS_EXT2_4=y
BR2_TARGET_ROOTFS_EXT2_SIZE="512M"

BR2_PACKAGE_HOST_DOSFSTOOLS=y
BR2_PACKAGE_HOST_DTC=y
BR2_PACKAGE_HOST_GENIMAGE=y
BR2_PACKAGE_HOST_MTOOLS=y
```

## configs/rpi4b_64_qnm_defconfig
```kconfig
# QNM Raspberry Pi 4B 64-bit defconfig
BR2_rpi4b_64=y
BR2_EXTERNAL_QNM_PATH="$(BR2_EXTERNAL)"

# ==================== System ====================
BR2_TARGET_GENERIC_HOSTNAME="rpi4b-qnm"
BR2_TARGET_GENERIC_GETTY_PORT="ttyAMA0"
BR2_TARGET_GENERIC_GETTY_BAUDRATE_115200=y
BR2_SYSTEM_DHCP="eth0"

# ==================== Rootfs customization ====================
BR2_ROOTFS_POST_BUILD_SCRIPT="board/qnm/raspberrypi/post-build.sh"
BR2_ROOTFS_POST_IMAGE_SCRIPT="board/qnm/raspberrypi/post-image.sh"
BR2_ROOTFS_OVERLAY="board/qnm/raspberrypi/rootfs_overlay"

# ==================== Kernel ====================
BR2_LINUX_KERNEL=y
BR2_LINUX_KERNEL_CUSTOM_TARBALL=y
BR2_LINUX_KERNEL_CUSTOM_TARBALL_LOCATION="$(call github,raspberrypi,linux,576cc10e1ed50a9eacffc7a05c796051d7343ea4)/linux-576cc10e1ed50a9eacffc7a05c796051d7343ea4.tar.gz"
BR2_LINUX_KERNEL_DEFCONFIG="bcm2711"
BR2_LINUX_KERNEL_DTS_SUPPORT=y
BR2_LINUX_KERNEL_INTREE_DTS_NAME="broadcom/bcm2711-rpi-4-b broadcom/bcm2711-rpi-400 broadcom/bcm2711-rpi-cm4 broadcom/bcm2711-rpi-cm4s"
BR2_LINUX_KERNEL_NEEDS_HOST_OPENSSL=y

# ==================== Raspberry Pi firmware & hardware ====================
BR2_PACKAGE_RPI_FIRMWARE=y
BR2_PACKAGE_RPI_FIRMWARE_VARIANT_PI4=y
BR2_PACKAGE_RPI_FIRMWARE_CONFIG_FILE="board/qnm/raspberrypi/config_4_64bit.txt"
BR2_PACKAGE_RPI_USERLAND=y
BR2_PACKAGE_BRCMFMAC_SDIO_FIRMWARE_RPI_WIFI=y

# ==================== Architecture ====================
BR2_aarch64=y
BR2_cortex_a72=y
BR2_ARM_FPU_VFPV4=y

# ==================== Toolchain ====================
BR2_PACKAGE_HOST_LINUX_HEADERS_CUSTOM_6_6=y
BR2_TOOLCHAIN_BUILDROOT_CXX=y

# ==================== Global settings ====================
BR2_GLOBAL_PATCH_DIR="board/raspberrypi/patches"
BR2_DOWNLOAD_FORCE_CHECK_HASHES=y

# ==================== Packages ====================
BR2_PACKAGE_BUSYBOX_SHOW_OTHERS=y
BR2_PACKAGE_XZ=y
BR2_PACKAGE_KMOD=y
BR2_PACKAGE_KMOD_TOOLS=y

# ==================== Filesystem ====================
BR2_TARGET_ROOTFS_EXT2=y
BR2_TARGET_ROOTFS_EXT2_4=y
BR2_TARGET_ROOTFS_EXT2_SIZE="512M"
# BR2_TARGET_ROOTFS_TAR is not set

# ==================== Host tools ====================
BR2_PACKAGE_HOST_DOSFSTOOLS=y
BR2_PACKAGE_HOST_GENIMAGE=y
BR2_PACKAGE_HOST_KMOD_XZ=y
BR2_PACKAGE_HOST_MTOOLS=y

# ==================== Bootloader: U-Boot ====================
BR2_TARGET_UBOOT=y
BR2_TARGET_UBOOT_BUILD_SYSTEM_KCONFIG=y

BR2_TARGET_UBOOT_CUSTOM_RSYNC=y
BR2_TARGET_UBOOT_CUSTOM_RSYNC_LOCATION="$(TOPDIR)/../uboot"

# BR2_TARGET_UBOOT_CUSTOM_GIT=y
# BR2_TARGET_UBOOT_CUSTOM_REPO_URL="https://github.com/quangnm145/u-boot.git"
# BR2_TARGET_UBOOT_CUSTOM_REPO_VERSION="qnm-rpi-dev"

BR2_TARGET_UBOOT_BOARD_DEFCONFIG="rpi_4_qnm"
BR2_TARGET_UBOOT_FORMAT_BIN=y
BR2_TARGET_UBOOT_NEEDS_PYLIBFDT=y
BR2_TARGET_UBOOT_NEEDS_OPENSSL=y
BR2_TARGET_UBOOT_NEEDS_GNUTLS=y
```

## package/qnm/Config.in
```kconfig
# QNM custom packages

menu "QNM Packages"
    source "$BR2_EXTERNAL_QNM_PATH/package/qnm/hello-world/Config.in"
endmenu
```

## package/qnm/hello-world/Config.in
```kconfig
config BR2_PACKAGE_HELLO_WORLD
    bool "hello-world"
    help
      Simple Hello World example package created in br2-external.
      
      This is a demonstration of how to add your own package.
```
